## scripts/kas_config/meta-selinux-mixin/conf/layer.conf
```bitbake
BBPATH =. "${LAYERDIR}:"

BBFILES += "${LAYERDIR}/recipes-*/*.bb \
            ${LAYERDIR}/recipes-*/*.bbappend"

BBFILE_COLLECTIONS += "meta-selinux-mixin"
BBFILE_PATTERN_meta-selinux-mixin = "^${LAYERDIR}/"
BBFILE_PRIORITY_meta-selinux-mixin = "6"

LAYERVERSION_meta-selinux-mixin = "1"

LAYERSERIES_COMPAT_meta-selinux-mixin = "dunfell gatesgarth hardknott honister kirkstone langdale mickledore nanbield scarthgap styhead walnascar whinlatter wrynose"
```

## scripts/kas_config/meta-swupdate-mixin/conf/layer.conf
```bitbake
BBPATH =. "${LAYERDIR}:"

BBFILES += "${LAYERDIR}/recipes-*/*.bb \
            ${LAYERDIR}/recipes-*/*.bbappend"

BBFILE_COLLECTIONS += "meta-swupdate-mixin"
BBFILE_PATTERN_meta-swupdate-mixin = "^${LAYERDIR}/"
BBFILE_PRIORITY_meta-swupdate-mixin = "6"

LAYERVERSION_meta-swupdate-mixin = "1"

LAYERSERIES_COMPAT_meta-swupdate-mixin = "dunfell gatesgarth hardknott honister kirkstone langdale mickledore nanbield scarthgap styhead walnascar whinlatter wrynose"

SWUPDATE_IMAGES_FSTYPES[core-image-swupdate] = ".ext4.gz"
SWUPDATE_IMAGES_FSTYPES[core-image-swupdate2] = ".ext4.gz"
```
